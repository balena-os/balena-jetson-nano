## layers/meta-balena-jetson/conf/layer.conf
```bitbake
BBPATH .= ":${LAYERDIR}"

BBFILES += "${LAYERDIR}/recipes-*/*/*.bb \
            ${LAYERDIR}/recipes-*/*/*.bbappend"

BBFILE_COLLECTIONS += "balena-jetson"
BBFILE_PATTERN_balena-jetson := "^${LAYERDIR}/"
BBFILE_PRIORITY_balena-jetson = "1337"

# kernel-image is installed by meta-tegra. We use kernel-image-initramfs
# Remove kernel-image package
MACHINE_ESSENTIAL_EXTRA_RDEPENDS_remove = "kernel-image"

MACHINE_ESSENTIAL_EXTRA_RRECOMMENDS += "tegra-nvpmodel tegra-configs-nvstartup tegra-configs-udev backport-iwlwifi"

BBMASK += "/meta-tegra/recipes-core/ "
BBMASK += "/meta-tegra/recipes-graphics/cairo "
BBMASK += "/meta-tegra/recipes-graphics/clutter "
BBMASK += "/meta-tegra/recipes-graphics/cogl "
BBMASK += "/meta-tegra/recipes-graphics/drm "
BBMASK += "/meta-tegra/recipes-graphics/mesa "
BBMASK += "/meta-tegra/recipes-graphics/vulkan "
BBMASK += "/meta-tegra/recipes-graphics/wayland "
BBMASK += "/meta-tegra/recipes-graphics/xorg-xserver "
BBMASK += "/meta-tegra/external/openembedded-layer/recipes-support/opencv/ "
BBMASK += "/meta-tegra/recipes-multimedia/gstreamer/"
BBMASK += "/meta-tegra/recipes-bsp/l4t-usb-device-mode/"

LAYERSERIES_COMPAT_balena-jetson = "dunfell"
LAYERSERIES_COMPAT_tegra = "dunfell"
SERIAL_CONSOLES_jetson-xavier = "115200;ttyTHS0"
SERIAL_CONSOLES_jetson-tx2 = "115200;ttyS0"
SERIAL_CONSOLES_jetson-tx1 = "115200;ttyS0"
SERIAL_CONSOLES_jetson-nano = "115200;ttyS0"
SERIAL_CONSOLES_jetson-nano-emmc = "115200;ttyS0"
SERIAL_CONSOLES_jetson-nano-2gb-devkit-emmc = "115200;ttyS0"
```

## layers/meta-balena-jetson/conf/machine/astro-tx2.conf
```bitbake
#@TYPE: Machine
##@NAME: astro-tx2
##@DESCRIPTION: Machine configuration for the CTI Astro Rev G+ Carrier Board for NVidia Jetson TX2

MACHINEOVERRIDES = "jetson-tx2:${MACHINE}"
include conf/machine/jetson-tx2.conf

MACHINEOVERRIDES := "${@'${MACHINEOVERRIDES}'.replace(':${MACHINE}',':jetson-tx2:${MACHINE}')}"
```

## layers/meta-balena-jetson/conf/machine/blackboard-tx2.conf
```bitbake
#@TYPE: Machine
##@NAME: blackboard-tx2
##@DESCRIPTION: Machine configuration for the blackboard

MACHINEOVERRIDES = "jetson-tx2:${MACHINE}"
ODMDATA ?= "0x7090000"
include conf/machine/jetson-tx2.conf

MACHINEOVERRIDES := "${@'${MACHINEOVERRIDES}'.replace(':${MACHINE}',':jetson-tx2:${MACHINE}')}"
```

## layers/meta-balena-jetson/conf/machine/cti-rogue-xavier.conf
```bitbake
#@TYPE: Machine
##@NAME: cti-rogue-xavier
##@DESCRIPTION: Machine configuration for the CTI Rogue Carrier Board for NVidia Jetson Xavier

MACHINEOVERRIDES = "jetson-xavier:${MACHINE}"
include conf/machine/jetson-xavier.conf

MACHINEOVERRIDES := "${@'${MACHINEOVERRIDES}'.replace(':${MACHINE}',':jetson-xavier:${MACHINE}')}"
```

## layers/meta-balena-jetson/conf/machine/jetson-nano-emmc.conf
```bitbake
#@TYPE: Machine
##@NAME: jetson-nano
##@DESCRIPTION: Machine configuration for the Devkit NANO

MACHINEOVERRIDES = "jetson-nano-devkit-emmc:${MACHINE}"
include conf/machine/jetson-nano-devkit-emmc.conf

MACHINEOVERRIDES := "${@'${MACHINEOVERRIDES}'.replace(':${MACHINE}',':jetson-nano-devkit-emmc:${MACHINE}')}"
```

## layers/meta-balena-jetson/conf/machine/jetson-nano.conf
```bitbake
#@TYPE: Machine
##@NAME: jetson-nano
##@DESCRIPTION: Machine configuration for the Devkit NANO

MACHINEOVERRIDES = "jetson-nano-devkit:${MACHINE}"
include conf/machine/jetson-nano-devkit.conf

MACHINEOVERRIDES := "${@'${MACHINEOVERRIDES}'.replace(':${MACHINE}',':jetson-nano-devkit:${MACHINE}')}"
```

## layers/meta-balena-jetson/conf/machine/jetson-tx1.conf
```bitbake
#@TYPE: Machine
##@NAME: jetson-tx1
##@DESCRIPTION: Machine configuration for the Jetson TX1 Devkit

MACHINEOVERRIDES = "jetson-tx1-devkit:${MACHINE}"
include conf/machine/jetson-tx1-devkit.conf

MACHINEOVERRIDES := "${@'${MACHINEOVERRIDES}'.replace(':${MACHINE}',':jetson-tx1-devkit:${MACHINE}')}"
```

## layers/meta-balena-jetson/conf/machine/jetson-tx2-4gb.conf
```bitbake
#@TYPE: Machine
##@NAME: jetson-tx2-4gb
##@DESCRIPTION: Machine configuration for the Jetson TX2 4GB (extends the base Jetson TX2 8GB)

MACHINEOVERRIDES = "jetson-tx2:${MACHINE}"
require conf/machine/jetson-tx2.conf

MACHINEOVERRIDES := "${@'${MACHINEOVERRIDES}'.replace(':${MACHINE}',':jetson-tx2:${MACHINE}')}"

KERNEL_DEVICETREE = "_ddot_/_ddot_/_ddot_/_ddot_/nvidia/platform/t18x/quill/kernel-dts/tegra186-quill-p3489-0888-a00-00-base.dtb"

EMMC_BCT = "P3489_Sku888_4GB_Hynix_4GB_lpddr4_204Mhz_P138_A02_l4t.cfg"

TEGRA_BOARDID = "3489"
TEGRA_FAB = "300"
TEGRA_BOARDSKU = "0888"
TEGRA_BOARDREV = ""
TEGRA_CHIPREV = "0"
# Extracted from l4t_generate_soc_bup.sh for BOARDID=3489 and board=jetson-tx2-4gb
TEGRA_BUPGEN_SPECS = "fab=300"
```

## layers/meta-balena-jetson/conf/machine/jetson-tx2-nx-devkit.conf
```bitbake
#@TYPE: Machine
##@NAME: jetson-tx2-nx-devkit
##@DESCRIPTION: Machine configuration for the Jetson TX2 NX in a Xavier NX Devkit carrier board

MACHINEOVERRIDES = "jetson-tx2:${MACHINE}"
include conf/machine/jetson-tx2.conf

MACHINEOVERRIDES := "${@'${MACHINEOVERRIDES}'.replace(':${MACHINE}',':jetson-tx2:${MACHINE}')}"

KERNEL_DEVICETREE = "_ddot_/_ddot_/_ddot_/_ddot_/nvidia/platform/t18x/lanai/kernel-dts/tegra186-p3636-0001-p3509-0000-a01.dtb"

MACHINE_FEATURES += "wifi bluetooth"
MACHINE_EXTRA_RRECOMMENDS += "kernel-module-rtk-btusb kernel-module-rtl8822ce tegra-firmware-rtl8822"
TEGRA_BT_SUPPORT_PACKAGE = ""

UBOOT_MACHINE = "p3636-0001_defconfig"

ODMDATA = "0x2090000"
EMMC_BCT = "tegra186-mb1-bct-memcfg-p3636-0001-a01.cfg"
NVIDIA_BOARD ?= "t186ref"
PARTITION_LAYOUT_TEMPLATE ?= "flash_l4t_t186.xml"

TEGRA_BOARDID = "3636"
TEGRA_FAB = "300"
TEGRA_BOARDSKU = "0001"
TEGRA_BOARDREV = ""
TEGRA_CHIPREV = "0"
# Extracted from l4t_generate_soc_bup.sh for BOARDID=3636 and board=jetson-xavier-nx-devkit-tx2-nx
TEGRA_BUPGEN_SPECS = "fab=300;boardsku=0001"
```

## layers/meta-balena-jetson/conf/machine/jetson-tx2.conf
```bitbake
#@TYPE: Machine
##@NAME: jetson-tx2
##@DESCRIPTION: Machine configuration for the Jetson TX2 Devkit

MACHINEOVERRIDES = "jetson-tx2-devkit:${MACHINE}"
include conf/machine/jetson-tx2-devkit.conf

MACHINEOVERRIDES := "${@'${MACHINEOVERRIDES}'.replace(':${MACHINE}',':jetson-tx2-devkit:${MACHINE}')}"
```

## layers/meta-balena-jetson/conf/machine/jetson-xavier.conf
```bitbake
#@TYPE: Machine
##@NAME: jetson-xavier
##@DESCRIPTION: Machine configuration for the Jetson Xavier AGX Devkit

MACHINEOVERRIDES = "jetson-agx-xavier-devkit:${MACHINE}"
include conf/machine/jetson-agx-xavier-devkit.conf

MACHINEOVERRIDES := "${@'${MACHINEOVERRIDES}'.replace(':${MACHINE}',':jetson-agx-xavier-devkit:${MACHINE}')}"
```

## layers/meta-balena-jetson/conf/machine/m2pcie-tx2.conf
```bitbake
#@TYPE: Machine
##@NAME: m2pcie-tx2
##@DESCRIPTION: Machine configuration for the TX2 dev board with ODMDATA configuration #1


MACHINEOVERRIDES = "jetson-tx2:${MACHINE}"
ODMDATA ?= "0x90000"
include conf/machine/jetson-tx2.conf
```

## layers/meta-balena-jetson/conf/machine/n310-tx2.conf
```bitbake
#@TYPE: Machine
##@NAME: n310-tx2
##@DESCRIPTION: Machine configuration for the Aetina N310 carrier board for NVidia Jetson TX2

MACHINEOVERRIDES = "jetson-tx2:${MACHINE}"
ODMDATA ?= "0x7090000"
ROOTFSSIZE="27GiB"
include conf/machine/jetson-tx2.conf

MACHINEOVERRIDES := "${@'${MACHINEOVERRIDES}'.replace(':${MACHINE}',':jetson-tx2:${MACHINE}')}"
```

## layers/meta-balena-jetson/conf/machine/nru120s-xavier.conf
```bitbake
#@TYPE: Machine
##@NAME: nru120s-xavier
##@DESCRIPTION: Machine configuration for the NRU120s Carrier Board for NVidia Jetson Xavier

MACHINEOVERRIDES = "jetson-xavier:${MACHINE}"
include conf/machine/jetson-xavier.conf

MACHINEOVERRIDES := "${@'${MACHINEOVERRIDES}'.replace(':${MACHINE}',':jetson-xavier:${MACHINE}')}"
```

## layers/meta-balena-jetson/conf/machine/orbitty-tx2.conf
```bitbake
#@TYPE: Machine
##@NAME: orbitty-tx2
##@DESCRIPTION: Machine configuration for the CTI Orbitty Carrier Board for NVidia Jetson TX2

MACHINEOVERRIDES = "jetson-tx2:${MACHINE}"
include conf/machine/jetson-tx2.conf

MACHINEOVERRIDES := "${@'${MACHINEOVERRIDES}'.replace(':${MACHINE}',':jetson-xavier:${MACHINE}')}"
```

## layers/meta-balena-jetson/conf/machine/skx2.conf
```bitbake
#@TYPE: Machine
##@NAME: skx2
##@DESCRIPTION: Machine configuration for the SKX2

MACHINEOVERRIDES = "jetson-tx2:${MACHINE}"
include conf/machine/jetson-tx2.conf
```

## layers/meta-balena-jetson/conf/machine/spacely-tx2.conf
```bitbake
#@TYPE: Machine
##@NAME: spacely-tx2
##@DESCRIPTION: Machine configuration for the CTI Spacely Carrier Board for NVidia Jetson TX2 with support for 6 IMX274 based cameras

MACHINEOVERRIDES = "jetson-tx2:${MACHINE}"
include conf/machine/jetson-tx2.conf

MACHINEOVERRIDES := "${@'${MACHINEOVERRIDES}'.replace(':${MACHINE}',':jetson-tx2:${MACHINE}')}"
```
